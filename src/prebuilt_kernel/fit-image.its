## src/prebuilt_kernel/fit-image.its
```
/dts-v1/;
/{
	description = "Simple Image with single linux kernel";
	#address-cells = <0x01>;

	images {
		kernel@1 {
			description = "aw linux Image.gz";
			data = /incbin/("./Image.gz");
			type = "kernel";
			arch = "arm64";
			os = "linux";
			compression = "gzip";
			load = <0x40080000>;
			entry = <0x40080000>;
		};
	};

	configurations {
		default = "config@1";
		config@1 {
			description = "only linux kernel";
			kernel = "kernel@1";
		};
	};
};
```
